## buildroot/configs/asus_rt_n10_b1_defconfig
```kconfig
BR2_mipsel=y
BR2_mips_32r2=y
BR2_TOOLCHAIN_BUILDROOT_MUSL=y
BR2_KERNEL_HEADERS_7_3=y
BR2_OPTIMIZE_S=y
BR2_GLOBAL_PATCH_DIR="board/rt-n10/patches"
BR2_TARGET_GENERIC_HOSTNAME="rt-n10"
BR2_TARGET_GENERIC_ISSUE="RT-N10 B1"
# BR2_TARGET_GENERIC_GETTY is not set
# BR2_TARGET_GENERIC_REMOUNT_ROOTFS_RW is not set
BR2_ROOTFS_OVERLAY="board/rt-n10/rootfs-overlay"
BR2_ROOTFS_POST_BUILD_SCRIPT="board/rt-n10/post-build.sh"
BR2_ROOTFS_POST_IMAGE_SCRIPT="board/rt-n10/post-image.sh"
BR2_LINUX_KERNEL=y
BR2_LINUX_KERNEL_USE_CUSTOM_CONFIG=y
BR2_LINUX_KERNEL_CUSTOM_CONFIG_FILE="board/rt-n10/linux.config"
BR2_LINUX_KERNEL_LZMA=y
BR2_LINUX_KERNEL_NEEDS_HOST_OPENSSL=y
BR2_PACKAGE_BUSYBOX_CONFIG="board/rt-n10/busybox.config"
BR2_PACKAGE_DNSMASQ=y
# BR2_PACKAGE_DNSMASQ_TFTP is not set
BR2_PACKAGE_DROPBEAR=y
# BR2_PACKAGE_DROPBEAR_CLIENT is not set
BR2_PACKAGE_DROPBEAR_DISABLE_REVERSEDNS=y
BR2_PACKAGE_DROPBEAR_LOCALOPTIONS_FILE="board/rt-n10/dropbear-localoptions.h"
BR2_PACKAGE_HOSTAPD=y
# BR2_PACKAGE_HOSTAPD_ACS is not set
# BR2_PACKAGE_HOSTAPD_VLAN is not set
BR2_PACKAGE_IPTABLES=y
BR2_PACKAGE_WIRELESS_REGDB=y
BR2_TARGET_ROOTFS_CPIO_LZMA=y
BR2_TARGET_ROOTFS_INITRAMFS=y
BR2_TARGET_ROOTFS_SQUASHFS=y
BR2_TARGET_ROOTFS_SQUASHFS4_XZ=y
```
